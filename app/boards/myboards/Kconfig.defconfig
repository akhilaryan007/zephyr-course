## app/boards/myboards/Kconfig.defconfig
```kconfig
config BOARD_MYBOARDS
    bool
    select SOC_SERIES_MCXA
    select SOC_MCXA156
    select SOC_PART_NUMBER_MCXA156VLL
```

## app/boards/myboards/Kconfig.myboards
```kconfig
# config BOARD_MYBOARDS
# 	select SOC_MCXA156 if BOARD_MY_BOARDS
# 	select SOC_PART_NUMBER_MCXA156VLL

# config BOARD_MYBOARDS
#     bool "My Boards"
#     select SOC_SERIES_MCXA
#     select SOC_MCXA156


config BOARD_MYBOARDS
    bool "My Boards"
```

## app/boards/myboards/board.yml
```yaml
board:
  name: myboards
  full_name: My Board From Scratch
  vendor: iomico
  socs:
  - name: mcxa156
```

## app/boards/our_board/Kconfig.defconfig
```kconfig
if BOARD_OUR_BOARD

if BOOTLOADER_MCUBOOT
choice MCUBOOT_BOOTLOADER_MODE
    default MCUBOOT_BOOTLOADER_MODE_OVERWRITE_ONLY
endchoice
endif # BOOTLOADER_MCUBOOT
endif # BOARD_OUR_BOARD
```
